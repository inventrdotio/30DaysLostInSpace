// DEFINES
#define SW 2 // RotaryEncoder SW Pin
#define DT 3 // RotaryEncoder DT Pin
#define CLK 4 // RotaryEncoder CLK Pin
#define SuccessfulLandingIndicator 5 // LED 
#define LandingInitLever A1 // Dip 1 Pin
#define LandingConfigLever A2 // Dip 2 Pin
#define LandingFinalLever A3 // Dip 3 Pin

// LIBRARIES
#include "U8glib.h"
#include <Keypad.h>

int displayBitmap = 0; // chooses which face to draw on the OLED in draw()
const byte ROWS = 4;
const byte COLS = 4; 
int wasPressed = 0; // Was the right key pressed on the 4x4 yet?
int leversActivated = 0; // was the dip switch completed?
unsigned long previousMillis = 0; 
int System_Error = 0;

// ROTARY ENCODER STUFFS
int counter = 30; //SAME AS ALTITIDE
int ALTITUDE = 30; //SAME AS COUNTER
int currentStateCLK;
int lastStateCLK;
String currentDir ="";
int READY = 0;



char buttons[ROWS][COLS] = {
  {'1', '2', '3', 'A'},
  {'4', '5', '6', 'B'},
  {'7', '8', '9', 'C'},
  {'*', '0', '#', 'D'}
};

byte rowPins[ROWS] = {13, 12, 11, 10};
byte colPins[COLS] = {9, 8, 7, 6}; 

Keypad customKeypad = Keypad(makeKeymap(buttons), rowPins, colPins, ROWS, COLS);

// MANDADTORY OLED CONFIGURATION
U8GLIB_SH1106_128X64 u8g(U8G_I2C_OPT_NONE);  // I2C / TWI
 
// OLED CONSTANTS
const uint8_t OFF[] = {0, 0, 0, 0};

static unsigned char defaultFace [] U8G_PROGMEM = {
   0x00, 0x00, 0x00, 0x00, 0x00, 0x00, 0x00, 0x00, 0x00, 0x00, 0x00, 0x00,
   0x00, 0x00, 0x00, 0x00, 0x00, 0x00, 0x00, 0x00, 0x00, 0x00, 0x00, 0x00,
   0x00, 0x00, 0x00, 0x00, 0x00, 0x00, 0x00, 0x00, 0x00, 0x00, 0x00, 0x00,
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   0x00, 0x00, 0x00, 0x00 };

static unsigned char partyFace [] U8G_PROGMEM = {
   0x00, 0x00, 0x00, 0x00, 0x00, 0x00, 0x00, 0x00, 0x00, 0x00, 0x00, 0x00,
   0x00, 0x00, 0x00, 0x00, 0x00, 0x00, 0x00, 0x00, 0x00, 0x00, 0x00, 0x00,
   0x00, 0x00, 0x00, 0x00, 0x00, 0x00, 0x00, 0x00, 0x00, 0x00, 0x00, 0x00,
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   0x00, 0x00, 0x00, 0x00 };

static unsigned char yikesFace [] U8G_PROGMEM = {
   0x00, 0x00, 0x00, 0x00, 0x00, 0x00, 0x00, 0x00, 0x00, 0x00, 0x00, 0x00,
   0x00, 0x00, 0x00, 0x00, 0x00, 0x00, 0x00, 0x00, 0x00, 0x00, 0x00, 0x00,
   0x00, 0x00, 0x00, 0x00, 0x00, 0x00, 0x00, 0x00, 0x00, 0x00, 0x00, 0x00,
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   0x00, 0x00, 0x00, 0x00 };


static unsigned char increase [] U8G_PROGMEM = {
   0x00, 0x00, 0x00, 0x00, 0x00, 0x00, 0x00, 0x00, 0x00, 0x00, 0x00, 0x00,
   0x00, 0x00, 0x00, 0x00, 0x00, 0x00, 0x00, 0x00, 0x00, 0x00, 0x00, 0x00,
   0x00, 0x00, 0x00, 0x00, 0x00, 0x00, 0x00, 0x00, 0x00, 0x00, 0x00, 0x00,
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   0x00, 0x00, 0x00, 0x00 };


static unsigned char decrease [] U8G_PROGMEM = {
   0x00, 0x00, 0x00, 0x00, 0x00, 0x00, 0x00, 0x00, 0x00, 0x00, 0x00, 0x00,
   0x00, 0x00, 0x00, 0x00, 0x00, 0x00, 0x00, 0x00, 0x00, 0x00, 0x00, 0x00,
   0x00, 0x00, 0x30, 0x00, 0x00, 0x00, 0x00, 0x00, 0x00, 0x00, 0x00, 0x00,
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   0x00, 0x00, 0x00, 0x00 };


static unsigned char checkmark [] U8G_PROGMEM = {
   0x00, 0x00, 0x00, 0x00, 0x00, 0x00, 0x00, 0x00, 0x00, 0x00, 0x00, 0x00,
   0x00, 0x00, 0x00, 0x00, 0x00, 0x00, 0x00, 0x00, 0x00, 0x00, 0x00, 0x00,
   0x00, 0x00, 0x00, 0x00, 0x00, 0x00, 0x00, 0x00, 0x00, 0x00, 0x00, 0x00,
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   0x00, 0x00, 0x00, 0x00 };


static unsigned char threeCheck [] U8G_PROGMEM = {
   0x00, 0x00, 0x00, 0x00, 0x00, 0x00, 0x00, 0x00, 0x00, 0x00, 0x00, 0x00,
   0x00, 0x00, 0x00, 0x00, 0x00, 0x00, 0x00, 0x00, 0x00, 0x00, 0x00, 0x00,
   0x00, 0x00, 0x00, 0x00, 0x00, 0x00, 0x00, 0x00, 0x00, 0x00, 0x00, 0x00,
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   0x00, 0x00, 0x00, 0x00 };

static unsigned char lowThrottle [] U8G_PROGMEM = {
   0x00, 0x00, 0x00, 0x00, 0x00, 0x00, 0x00, 0x00, 0x00, 0x00, 0x00, 0x00,
   0x00, 0x00, 0x00, 0x00, 0x00, 0x00, 0x00, 0x00, 0x00, 0x00, 0x00, 0x00,
   0x00, 0x00, 0x00, 0x00, 0x00, 0x00, 0x00, 0x00, 0x00, 0x00, 0x00, 0x00,
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   0x00, 0x00, 0x00, 0x00 };


static unsigned char optimalThrottle [] U8G_PROGMEM = {
   0x00, 0x00, 0x00, 0x00, 0x00, 0x00, 0x00, 0x00, 0x00, 0x00, 0x00, 0x00,
   0x00, 0x00, 0x00, 0x00, 0x00, 0x00, 0x00, 0x00, 0x00, 0x00, 0x00, 0x00,
   0x00, 0x00, 0x00, 0x00, 0x00, 0x00, 0x00, 0x00, 0x00, 0x00, 0x00, 0x00,
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   0x00, 0x00, 0x00, 0x00 };

static unsigned char highThrottle [] U8G_PROGMEM = {
   0x00, 0x00, 0x00, 0x00, 0x00, 0x00, 0x00, 0x00, 0x00, 0x00, 0x00, 0x00,
   0x00, 0x00, 0x00, 0x00, 0x00, 0x00, 0x00, 0x00, 0x00, 0x00, 0x00, 0x00,
   0x00, 0x00, 0x00, 0x00, 0x00, 0x00, 0x00, 0x00, 0x00, 0x00, 0x00, 0x00,
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   0x00, 0x00, 0x00, 0x00 };

static unsigned char error [] U8G_PROGMEM = {
   0x00, 0x00, 0x00, 0x00, 0x00, 0x00, 0x00, 0x00, 0x00, 0x00, 0x00, 0x00,
   0x00, 0x00, 0x00, 0x00, 0x00, 0x00, 0x00, 0x00, 0x00, 0x00, 0x00, 0x00,
   0x00, 0x00, 0x00, 0x00, 0x00, 0x00, 0x00, 0x00, 0x00, 0x00, 0x00, 0x00,
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   0x00, 0x00, 0x00, 0x00 };

// OLED Display output
void draw(void) {
  // graphic commands to redraw the complete screen should be placed here  
  u8g.setFont(u8g_font_unifont);

  CoordinateKeypadCheck();

  if(System_Error == 1) {
    displayBitmap = 10;
  }
  
  switch (displayBitmap) {
      case 0:
        u8g.drawXBMP( 0, 0, 128, 64, defaultFace);
        break;
      case 1:
        u8g.drawXBMP( 0, 0, 128, 64, partyFace);
        break;
      case 2:
        u8g.drawXBMP( 0, 0, 128, 64, yikesFace);
        break;
      case 3:
        u8g.drawXBMP( 0, 0, 128, 64, increase);
        break;
      case 4:
        u8g.drawXBMP( 0, 0, 128, 64, decrease);
        break;
      case 5:
        u8g.drawXBMP( 0, 0, 128, 64, checkmark);
        break;
      case 6:
        u8g.drawXBMP( 0, 0, 128, 64, threeCheck);
        break;
      case 7:
        u8g.drawXBMP( 0, 0, 128, 64, lowThrottle);
        break;
      case 8:
        u8g.drawXBMP( 0, 0, 128, 64, optimalThrottle);
        break;
      case 9:
        u8g.drawXBMP( 0, 0, 128, 64, highThrottle);
        break;
      case 10:
        u8g.drawXBMP( 0, 0, 128, 64, error);
        break;
    }
}

int calculateFace(){

  if(leversActivated == 1){
    return 0; //ALREADY COMPLETED DIP SWITCH SECTION
  }
  
  // READ THE DIP SWITCH
  if(digitalRead(LandingInitLever) != 0) {
    displayBitmap = 7;
  }
  if(digitalRead(LandingConfigLever) != 0){
    displayBitmap = 8;
  }
  if(digitalRead(LandingFinalLever) != 0){
    displayBitmap = 9;
  }
  if(digitalRead(LandingInitLever) != 0
     && digitalRead(LandingConfigLever) != 0
     && digitalRead(LandingFinalLever) != 0) {
      displayBitmap = 5;
      leversActivated = 1;
      return 0;
     }
  return -1;
}

int CoordinateKeypadCheck() {
  if(calculateFace() < 0 && leversActivated == 0) { // WAIT TO MAKE SURE DIP SWITCH IS READY BEFORE CONINUING
    return -1;
  }
  char customKey = customKeypad.getKey();
  
  if (customKey == 'A') { // if correct coordinate pressed
    displayBitmap = 2;
    wasPressed = 1;
    Serial.println(customKey);
    return 0;
  }
  else if (wasPressed == 1 && displayBitmap == 2) {
    displayBitmap = 1;
    Serial.println(customKey); 
  }
  return -1;
}

void beginCountDown() {
  ALTITUDE = ALTITUDE - 1;

  if(ALTITUDE <= 0 && System_Error == 0){
    digitalWrite(SuccessfulLandingIndicator, HIGH);
    displayBitmap = 0;
    ALTITUDE = 0;
    //SUCESSFULLY LANDED!!!!!!!!!!!!
  }
  else if(ALTITUDE > counter) {
    displayBitmap = 3;
  }
  else if(ALTITUDE < counter){
    displayBitmap = 4;
  }
  if((ALTITUDE - counter) > 5 || (counter - ALTITUDE) > 5) {
    Serial.println("TOO FAR OUT OF RANGE: RESTART!");
    displayBitmap = 10;
    System_Error = 1; //ERROR TIME
  }
  Serial.println(ALTITUDE);
}

int updateEncoder(){

  if(wasPressed != 1) {
    return -1;
  }
  else {
    READY = 1;
  }
  
  // Read the current state of CLK
  currentStateCLK = digitalRead(CLK);
 
  // If last and current state of CLK are different, then pulse occurred
  // React to only 1 state change to avoid double count
  if (currentStateCLK != lastStateCLK  && currentStateCLK == 1){
 
    // If the DT state is different than the CLK state then
    // the encoder is rotating CCW so decrement
    if (digitalRead(DT) != currentStateCLK) {
      counter --;
      currentDir ="UP";
    } else {
      // Encoder is rotating CW so increment
      counter ++;
      currentDir ="DOWN";
    }
 
    Serial.print("Direction: ");
    Serial.print(currentDir);
    Serial.print(" | Counter: ");
    Serial.println(counter);

    return 0;
  }
 
  // Remember last CLK state
  lastStateCLK = currentStateCLK;
}
 
void setup(){
  Serial.begin(9600);
 
  pinMode(LandingInitLever, INPUT);
  pinMode(LandingConfigLever, INPUT);
  pinMode(LandingFinalLever, INPUT);
  pinMode(SuccessfulLandingIndicator, OUTPUT);
  
  // Set encoder pins as inputs
  pinMode(CLK, INPUT);
  pinMode(DT, INPUT);
  
  u8g.setColorIndex(1); // pixel on

  displayBitmap = 0;

  // Read the initial state of CLK
  lastStateCLK = digitalRead(CLK);

  attachInterrupt(0, updateEncoder, CHANGE);
  attachInterrupt(1, updateEncoder, CHANGE);
}
 
 
void loop(){
 char customKey = customKeypad.getKey();
  
 u8g.firstPage();
  do {
    draw();
  } while( u8g.nextPage() );


  unsigned long currentMillis = millis();

  if (currentMillis - previousMillis >= 1000) {
    // save the last time you blinked the LED
    previousMillis = currentMillis;
    
    if(READY == 1) {
      beginCountDown();
    }
  }
}
